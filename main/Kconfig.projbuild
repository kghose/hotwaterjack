## main/Kconfig.projbuild
```kconfig
menu "WIFI Config"
    config ESP_WIFI_SSID
        string "WiFi SSID"
        help
            SSID (network name) to connect to.

    config ESP_WIFI_PASSWORD
        string "WiFi Password"
        help
            WiFi password.
endmenu
```
